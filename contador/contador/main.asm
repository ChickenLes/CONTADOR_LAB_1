
;-----------------------------------------------
; Universidad del Valle de Guatemala
; IE2023: Programacion de Microcontroladores
; CONTADOR_LAB.asm
; Autor: ANTHONY ALEJANDR BOTEO LÓPEZ
; Proyecto: LABORATORIO 1
; Hardware: ATMEGA328P
; Creado: 7/02/2025 
; Ultima modificacion: 13/02/2025
;DESCRIPCIÓN:CONTADORES DE 4 BITS. PB0 - PB3 MUESTRAN EL CONTADOR 1 Y PC0 - PC3 MUESTRAN EL CONTADOR 2.
;LOS PINES PD2 Y PD4 CONTROLAN EL INCREMENTO Y DECREMENTO DEL CONTADOR 1, MIENTRAS QUE LOS PINES PD5 Y PD6 CONTROLAN EL INCREMENTO Y DECREMENTO DEL CONTADOR 2.
;-----------------------------------------------

.include "M328PDEF.inc"

.cseg
.org	0x0000	//DIRECCION DEL RESET

//PILA
LDI		R16, LOW(RAMEND)
OUT		SPL, R16
LDI		R16, HIGH(RAMEND)
OUT		SPH, R16

//CONFIGURAR REGISTROS
// R16: USO GENERAL
// R17: ESTADO DEL BOTÓN LUEGO DEL BOUNCING
// R18: VALOR PARA CONTADOR 1 (PORTB)
// R19: VALOR INICIAL PARA EL DELAY
// R20: VALOR PARA CONTADOR 2 (PORTC)


//CONFIGURACIÓN DE PUERTOS
SETUP:
	// CONFIGURANDO PORTB Y PORTC COMO SALIDA (CONTADOR 1)
	LDI		R16, 0xFF
	OUT		DDRB, R16	//PUERTO B COMO SALIDA
	OUT		DDRC, R16	//PUERTO C COMO SALIDA
	LDI		R16, 0x00	
	OUT		PORTB, R16	//PUERTO B PULL UP DESACTIVADO
	OUT		PORTC, R16	//PUERTO C PULL UP DESACTIVADO

	 

	// CONFIGURANDO PORTD COMO ENTRADA (BOTONES)
	OUT		DDRD, R16	
	LDI		R16, 0xFF
	OUT		PORTD, R16	

	// VALOR INICIAL DE CONTADORES

	LDI		R17, 0xFF	//VALOR PARA GUARDAR EL ESTADO DEL PIN
	LDI		R18, 0x00	//VALOR INICIAL DEL CONTADOR 1
	LDI		R20, 0x00	//VALOR INICIAL DEL CONTADOR 2


MAIN:
	//ANTIREBOTE
	IN		R16, PIND
	CP		R17, R16
	BREQ	MAIN
	
	CALL	DELAY
	IN		R16, PIND	//VERIFICAR QUE SI EL ESTADO DE LECTURA ES CORRECTO	
	CP		R17, R16
	BREQ	MAIN

	MOV		R17, R16	//GUARDA EL NUEVO ESTADO(POR SI SE MANTIENE PRESIONADO)


	CALL	 CONTROL1
	CALL	 CONTROL2
	RJMP	 MAIN	

///////////////////// CONTROLES PINES ////////////////////
CONTROL1:
	
	CPI		R16, 0xFB	//VERIFICA SI PD2 FUE PRESIONADO (0b1111 1"0"11)
	BREQ	SUMA

	CPI		R16, 0xEF	//VERIFICAR SI PD4 FUE PRESIONADO(0b111"0" 1111)
	BREQ	RESTA
	RET

CONTROL2:
	
	CPI		R16, 0xDF	//VERIFICA SI PD5 FUE PRESIONADO (0b11"0"1 1111)
	BREQ	SUMA2

	CPI		R16, 0xBF	//VERIFICA SI PD6 FUE PRESIONADO (0b1"0"11 1111)
	BREQ	RESTA2
	RET

///////////////////////// CONTADORES /////////////////////
SUMA:

	INC		R18			//INCREMENTA EL VALOR DEL CONTADOR 1
	ANDI	R18, 0x0F	//MASCARA PARA QUEDARNOS EN 4 BITS
	OUT		PORTB, R18	//MOSTRAR EL RESULTADO EN PORTB 

	RJMP	MAIN

RESTA:

	DEC		R18			//DECREMENTA EL VALOR DEL CONTADOR 1
	ANDI	R18, 0x0F	//MASCARA PARA QUEDARNOS EN 4 BITS

	OUT		PORTB, R18	//MOSTRAR EL RESULTADO EN PORTB

	RJMP	MAIN

SUMA2:

	INC		R20			//INCREMENTA EL VALOR DEL CONTADOR 2
	ANDI	R20, 0x0F	//MASCARA PARA QUEDARNOS EN 4 BITS 

	OUT		PORTC, R20	//MOSTRAR EL RESULTADO EN PORTB  

	RJMP	MAIN

RESTA2:

	DEC		R20			//DECREMENTA EL VALOR DEL CONTADOR 2
	ANDI	R20, 0x0F	//MASCARA PARA QUEDARNOS EN 4 BITS
	 
	OUT		PORTC, R20	//MOSTRAR EL RESULTADO EN PORTB	

	RJMP	MAIN




/////////////////////////////// DELAY /////////////////////////
DELAY:
    LDI     R19, 0xFF
SUB_DELAY1:
    DEC     R19
    CPI     R19, 0
    BRNE    SUB_DELAY1
    LDI     R19, 0xFF
SUB_DELAY2:
	DEC     R19
    CPI     R19, 0
    BRNE    SUB_DELAY2
    LDI     R19, 0xFF
SUB_DELAY3:
	DEC     R19
    CPI     R19, 0
    BRNE    SUB_DELAY3
	RET
		