;-----------------------------------------------
; Universidad del Valle de Guatemala
; IE2023: Programacion de Microcontroladores
; CONTADOR_POSTLAB.asm
; Autor: ANTHONY ALEJANDRO BOTEO LсPEZ
; Proyecto: LABORATORIO 1
; Hardware: ATMEGA328P
; Creado: 9/02/2025 
; Ultima modificacion: 12/02/2025
; DescripciСn:SUMADOR DE 4 BITS, QUE MUESTRA EL RESULTADO EN PD0 - PD3 SUMANDO LOS CONTADORES 1 Y 2. 
;EL CONTADOR 1 SE MUESTRA EN PD4 - PD7 Y EL CONTADOR 2 EN PB3 - PB5. 
;SI HAY CARRY, SE ENCIENDE UN LED EN PINC5. LOS BOTONES PC0 Y PC1 CONTROLAN EL INCREMENTO Y DECREMENTO DEL CONTADOR 1, MIENTRAS QUE PC2 Y PC3 CONTROLAN EL INCREMENTO Y DECREMENTO DEL CONTADOR 2. 
;PC4 FUNCIONA COMO EL BOTсN SUMADOR. EL RELOJ ESTа SETEADO A 1MHZ.
;-----------------------------------------------

.include "M328PDEF.inc"

.cseg
.org	0x0000

LDI R16, (1 << CLKPCE)    ; Habilitar cambios en CLKPR (CLKPCE = 1)
STS CLKPR, R16   ; Escribir en CLKPR para desbloquear cambios
LDI R16, 0b00000100    ; Configurar prescaler a 8 (8 MHz / 8 = 1 MHz)
STS CLKPR, R16   ; Aplicar prescaler


//PILA
LDI		R16, LOW(RAMEND)
OUT		SPL, R16
LDI		R16, HIGH(RAMEND)
OUT		SPH, R16

//CONFIGURAR REGISTROS
// R16: LECTURA DEL PIN
// R17: ESTADO DEL BOTсN LUEGO DEL BOUNCING
// R18: VALOR PARA CONTADOR 1 (PORTB)
// R19: VALOR INICIAL PARA EL DELAY
// R20: VALOR PARA CONTADOR 2 (PORTC)
// R21: GUARDAR VALOR(SUMA Y RESTA / CONTADOR1 & CONTADOR2)
// R22: GUARDAR ESTADO R20 PARA SUMADOR	Y DELAYLARGO1
// R23: VALOR DELAYLARGO2

//CONFIGURACIсN DE PUERTOS
SETUP:
	// CONFIGURANDO PORTB Y PORTC COMO SALIDA (CONTADOR 1)
	LDI		R16, 0xFF
	OUT		DDRB, R16	//PUERTO B COMO SALIDA
	OUT		DDRD, R16	//PUERTO C COMO SALIDA
	LDI		R16, 0x00	
	OUT		PORTB, R16	//PUERTO B PULL UP DESACTIVADO
	OUT		PORTD, R16	//PUERTO C PULL UP DESACTIVADO

	 

	// CONFIGURANDO PORTD COMO ENTRADA (BOTONES)
	LDI		R16, 0x20	//0b00100000(0 es salida)
	OUT		DDRC, R16	
	LDI		R16, 0x1F	//0b00011111(pull up activado de 0 al 5 bit) SIRVE EN CARRY
	OUT		PORTC, R16	

	// VALOR INICIAL DE CONTADORES

	LDI		R17, 0xFF	//VALOR PARA GUARDAR EL ESTADO DEL PIN
	LDI		R18, 0x00	//VALOR INICIAL DEL CONTADOR 1
	LDI		R20, 0x00	//VALOR INICIAL DEL CONTADOR 2


MAIN:
	//ANTIREBOTE
	IN		R16, PINC
	CP		R17, R16
	BREQ	MAIN
	
	CALL	DELAY
	IN		R16, PINC	//VERIFICAR QUE SI EL ESTADO DE LECTURA ES CORRECTO	
	CP		R17, R16
	BREQ	MAIN

	MOV		R17, R16	//GUARDA EL NUEVO ESTADO(POR SI SE MANTIENE PRESIONADO)


	CALL	CONTROL1
	CALL	CONTROL2
	CALL	CONTROL3
	RJMP	MAIN	

///////////////////// CONTROLES PINES ////////////////////
CONTROL1:
	
	CPI		R16, 0x1E	//COMPARA CON 0001 111"0" EN PINC0 CONTADOR1(AUMENTO)
	BREQ	SUMA

	CPI		R16, 0x1D	//COMPARA CON 0001 11"0"1 EN PINC1 CONTADOR1(DECREMENTO)
	BREQ	RESTA
	RET

CONTROL2:
	
	CPI		R16, 0x1B	//COMPARA CON 0001 1"0"11 EN PINC2 CONTADOR2(AUMENTO)
	BREQ	SUMA2

	CPI		R16, 0x17	//COMPARA CON 0001 "0"111 EN PINC3 CONTADOR2(DECREMENTO)
	BREQ	RESTA2
	RET
CONTROL3:
	
	CPI		R16, 0x0F	// //COMPARA CON 000"0" 1111 EN PINC4 SUMADOR CONTADOR1 + CONTADOR2
	BREQ	SUMADOR
	RET

	

///////////////////CONTADOR1//////////////////////////////////////
SUMA:

	INC     R18			//INCREMENTA EL VALOR DE CONTADOR1 MAIN             
    MOV     R21, R18	//COPIAR EL VALOR ACTUAL DEL CONTADOR1    

    SWAP	R21			//SUBE LOS 4 BITS INFERIORES
	
	ANDI	R21, 0xF0	//MASCARA PARA PERMANECER EN 4 BITS
	OUT		PORTD, R21	//MUESTRA EL CONTADOR2 EN PORTB

    RJMP    MAIN             




RESTA:
	
	DEC		R18			//INCREMENTA EL VALOR DE CONTADOR1 MAIN 
	MOV		R21, R18	//COPIAR EL VALOR ACTUAL DEL CONTADOR1
	
	SWAP	R21			//SUBE LOS 4 BITS INFERIORES
	
	ANDI	R21, 0xF0	//MASCARA PARA PERMANECER EN 4 BITS
	OUT		PORTD, R21	//MUESTRA EL CONTADOR2 EN PORTB

	RJMP    MAIN



///////////////////CONTADOR2//////////////////////////////////////
SUMA2:
	
	INC     R20			//INCREMENTA EL VALOR DE CONTADOR2 MAIN
	ANDI    R20, 0x0F	//MASCARA PARA QUE EL CONTADOR SE MANTENGA EN 4 BITS

	
	MOV     R22, R20	//COPIAR EL VALOR ACTUAL DEL CONTADOR2

	//DESPLAZAR BITS PARA QUE SE MUESTREN EN PB3 - PB5

	LSL     R22			//DESPLAZAR BIT A LA IZQUIERDA
	LSL     R22			//DESPLAZAR BIT A LA IZQUIERDA

	OUT     PORTB, R22	//MUESTRA EL CONTADOR2 EN PORTB

	RJMP    MAIN

RESTA2:

	DEC     R20			//DECREMENTA EL VALOR DE CONTADOR2 MAIN
	ANDI    R20, 0x0F	//MASCARA PARA QUE EL CONTADOR SE MANTENGA EN 4 BITS	

	MOV     R22, R20	//COPIAR EL VALOR ACTUAL DEL CONTADOR2

	//DESPLAZAR BITS PARA QUE SE MUESTREN EN PB3 - PB5

	LSL     R22			//DESPLAZAR BIT A LA IZQUIERDA
	LSL     R22			//DESPLAZAR BIT A LA IZQUIERDA

	OUT     PORTB, R22	//MUESTRA EL CONTADOR2 EN PORTB

	RJMP    MAIN

///////////////////////////////SUMADOR//////////////////////////
SUMADOR:
	
	MOV		R22, R20	//COPIA COUNT2 EN R22
	ADD		R22, R18	//SUMA COUNT2 Y COUNT1

	BRCS	CARRY		//SALTA SI CARRY ESTA ACTIVADO SI LA SUMA SUPERA (0x0F)

	ANDI	R22, 0x0F	//MASCARA PARA NO AFECTAR LOS OTROS PINES EN PORTD
	OUT		PORTD, R22	//MUESTRA LA SUMA DE LOS DOS CONTADORES EN PORTD
		
	RJMP	MAIN



///////////////////////////////CARRY///////////////////////////
CARRY:
	
	SBI		PORTC, 5	//SET PINC5 EN 1
	ANDI	R22, 0x0F	//MASCARA PARA MANTENER 4 BITS
	OUT		PORTD, R22	//SALIDA DE R22 EN PORTD

	CALL	DELAY_L

	CBI		PORTC, 5	//SET PINC5 EN 0

	RJMP	MAIN


/////////////////////////////// DELAY /////////////////////////
DELAY:
    LDI     R19, 0xFF
SUB_DELAY1:
    DEC     R19
    CPI     R19, 0
    BRNE    SUB_DELAY1
    LDI     R19, 0xFF
SUB_DELAY2:
	DEC     R19
    CPI     R19, 0
    BRNE    SUB_DELAY2
    LDI     R19, 0xFF
SUB_DELAY3:
	DEC     R19
    CPI     R19, 0
    BRNE    SUB_DELAY3
	RET
		
///////////////////////////// DELAY LARGO PARA CARRY //////////
DELAY_L:
	
	LDI		R22, 0xFF
	LDI		R23, 0xFF

SUB_DELAYL:

	DEC		R22
	BRNE	SUB_DELAYL
	DEC		R23
	BRNE	SUB_DELAYL
	LDI		R22, 0xFF
	LDI		R23, 0xFF


SUB_DELAYL2:

	DEC		R22
	BRNE	SUB_DELAYL2
	DEC		R23
	BRNE	SUB_DELAYL2
	LDI		R22, 0xFF
	LDI		R23, 0xFF

SUB_DELAYL3:

	DEC		R22
	BRNE	SUB_DELAYL3
	DEC		R23
	BRNE	SUB_DELAYL3
	LDI		R22, 0xFF
	LDI		R23, 0xFF

SUB_DELAYL4:

	DEC		R22
	BRNE	SUB_DELAYL4
	DEC		R23
	BRNE	SUB_DELAYL4
	LDI		R22, 0xFF
	LDI		R23, 0xFF

SUB_DELAYL5:

	DEC		R22
	BRNE	SUB_DELAYL5
	DEC		R23
	BRNE	SUB_DELAYL5
	LDI		R22, 0xFF
	LDI		R23, 0xFF

SUB_DELAYL6:
	DEC		R22
	BRNE	SUB_DELAYL6
	DEC		R23
	BRNE	SUB_DELAYL6

	RET